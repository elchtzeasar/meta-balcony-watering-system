## conf/layer.conf
```bitbake
# We have a conf and classes directory, add to BBPATH
BBPATH .= ":${LAYERDIR}"

# We have recipes-* directories, add to BBFILES
BBFILES += "${LAYERDIR}/recipes-*/*/*.bb \
            ${LAYERDIR}/recipes-*/*/*.bbappend"

BBFILE_COLLECTIONS += "meta-balcony-watering-system"
BBFILE_PATTERN_meta-balcony-watering-system = "^${LAYERDIR}/"
BBFILE_PRIORITY_meta-balcony-watering-system = "6"

LAYERDEPENDS_meta-balcony-watering-system = "core"
LAYERSERIES_COMPAT_meta-balcony-watering-system = "thud"
```
